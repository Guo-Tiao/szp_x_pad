## main/Kconfig.projbuild
```kconfig
menu "Szp Project Config"
    
    #项目配置项
    menu "项目配置"
        config SZP_PROJECT_RUN_DEMO
            bool "运行demo"
            default n
    endmenu
    
    #项目宏定义相关
    menu "项目定义"
        config USE_SZP_ESP_ERR_CHECK
            bool "使用自定义ESP_ERR_CHECK"
            default n
        config ENABLE_SZP_IOT    
            bool "使能物联网(开启WIFI和蓝牙)"
            default n    
    endmenu

    #扩展接口配置项
    menu "扩展接口配置"
        choice SZP_EXP_ITF_FUNCTION
            prompt "扩展接口功能"
            default SZP_EXP_ITF_FUNC_UART   
    
            config SZP_EXP_ITF_FUNC_NONE
                bool "NONE"
            config SZP_EXP_ITF_FUNC_UART
                bool "UART"
            config SZP_EXP_ITF_FUNC_CAN
                bool "CAN"
            config SZP_EXP_ITF_FUNC_USB
                bool "USB"    
            config SZP_EXP_ITF_FUNC_GPIO
                bool "GPIO"
        endchoice

        #使能串口配置时
        if SZP_EXP_ITF_FUNC_UART
            menu "扩展串口配置"
                #串口引脚选择
                choice SZP_EXP_ITF_UART_RX_TX
                    prompt "串口配置引脚"
                    default SZP_EXP_ITF_UART_RX_TX_1   

                    config SZP_EXP_ITF_UART_RX_TX_1
                        bool "RX-IO18/TX-IO19"
                    config SZP_EXP_ITF_UART_RX_TX_2
                        bool "RX-IO19/TX-IO18"
                endchoice
                #串口波特率        
                choice 
                    prompt "串口波特率"
                    default SZP_EXP_ITF_UART_BAUD_115200  

                    config SZP_EXP_ITF_UART_BAUD_9600
                        bool "9600"
                    config SZP_EXP_ITF_UART_BAUD_19200
                        bool "19200"
                    config SZP_EXP_ITF_UART_BAUD_38400
                        bool "38400"
                    config SZP_EXP_ITF_UART_BAUD_57600
                        bool "57600"
                    config SZP_EXP_ITF_UART_BAUD_115200
                        bool "115200"
                endchoice       
                #串口波特率设置        
                config  SZP_EXP_ITF_UART_BAUD
                    int
                    default 9600 if SZP_EXP_ITF_UART_BAUD_9600
                    default 19200 if SZP_EXP_ITF_UART_BAUD_19200
                    default 38400 if SZP_EXP_ITF_UART_BAUD_38400
                    default 57600 if SZP_EXP_ITF_UART_BAUD_57600
                    default 115200 if SZP_EXP_ITF_UART_BAUD_115200
                endmenu
                #串口接收缓存         
                config SZP_EXP_ITF_UART_RX_BUFFER
                    int "扩展串口接收缓存大小"
                    range 0   2048
                    default 1024
                #串口发送缓存
                config SZP_EXP_ITF_UART_TX_BUFFER
                        int "扩展串口发送缓存大小"
                        range 0   2048
                        default 1024
        endif 

    endmenu

    #项目宏定义相关
    menu "网络配置"
        menu "WIFI连接"
            config SZP_WIFI_SSID
                string "WiFi名称"
                default ""
            config SZP_WIFI_PASSWORD
                string "WiFi密码"
                default ""
            config SZP_WIFI_RETRY_COUNT
                int "WiFi重连次数"
                default 3
        endmenu
         menu "MQTT配置"
            config USE_SZP_MQTT
                bool "使用MQTT"
                default n
            if USE_SZP_MQTT
                config SZP_MQTT_BROKER_URI
                        string "Mqtt Broker Url"
                        default ""
                config SZP_MQTT_BROKER_PORK
                        int "Mqtt Borker 端口"
                        default 0
                config SZP_MQTT_CLIENT_ID
                            string "Mqtt 客户端 ID"
                            default ""    
                config SZP_MQTT_CLIENT_USERNAME
                            string "Mqtt 客户端 用户名"
                            default ""   
                config SZP_MQTT_CLIENT_PASSWORD
                        string "Mqtt 客户端 密码"
                        default ""   
            endif
        endmenu
    endmenu

endmenu
```
